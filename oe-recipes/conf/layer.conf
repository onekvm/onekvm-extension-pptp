## oe-recipes/conf/layer.conf
```bitbake
BBPATH .= ":${LAYERDIR}"
BBFILES += "${LAYERDIR}/recipes-*/*/*.bb ${LAYERDIR}/recipes-*/*/*.bbappend"
BBFILE_COLLECTIONS += "onekvm-extension-pptp"
BBFILE_PATTERN_onekvm-extension-pptp := "^${LAYERDIR}/"
BBFILE_PRIORITY_onekvm-extension-pptp = "8"
LAYERDEPENDS_onekvm-extension-pptp = "core onekvm"
LAYERSERIES_COMPAT_onekvm-extension-pptp = "wrynose"
```
